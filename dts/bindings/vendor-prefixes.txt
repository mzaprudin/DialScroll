## tests/encoder_math/testcase.yaml
```yaml
tests:
  blescroll.encoder_math:
    tags:
      - encoder
      - unit
    integration_platforms:
      - qemu_cortex_m3
```

## tests/scroll_settings/testcase.yaml
```yaml
tests:
  blescroll.scroll_settings:
    tags:
      - settings
      - unit
    integration_platforms:
      - qemu_cortex_m3
```
